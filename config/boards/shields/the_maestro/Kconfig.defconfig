## config/boards/shields/the_maestro/Kconfig.defconfig
```kconfig
if SHIELD_THE_MAESTRO_RIGHT

config ZMK_KEYBOARD_NAME
  default "The Maestro"

config ZMK_SPLIT_ROLE_CENTRAL
  default y

config ZMK_POINTING
  default y

config PAW3222
  default y

endif

if SHIELD_THE_MAESTRO_LEFT || SHIELD_THE_MAESTRO_RIGHT

config ZMK_SPLIT
  default y

config ZMK_SLEEP
  default y

config ZMK_RGB_UNDERGLOW
  default n

config WS2812_STRIP
  default n

config ZMK_EXT_POWER
  default n

endif
```

## config/boards/shields/the_maestro/Kconfig.shield
```kconfig
config SHIELD_THE_MAESTRO_LEFT
  def_bool $(shields_list_contains,the_maestro_left)

config SHIELD_THE_MAESTRO_RIGHT
  def_bool $(shields_list_contains,the_maestro_right)
```
